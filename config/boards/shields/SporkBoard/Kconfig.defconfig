## config/boards/shields/SporkBoard/Kconfig.defconfig
```kconfig
if SHIELD_TESTBOARD

# Name must be less than 16 characters long!
    config BOARD
        default "SporkBoard"

    config ZMK_KEYBOARD_NAME
        default "Spork Board"


    endif
```
